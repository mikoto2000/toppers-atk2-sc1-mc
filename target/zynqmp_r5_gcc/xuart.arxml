AUTOSAR XML (schema 4-0-3)
package /Ecuc
  module config Os: ecuc-def-edition=4.2.0, implementation-config-variant=VARIANT-PRE-COMPILE
    OSAP_for_RxHwSerialInt0 (OsApplication): OsTrusted=true, OsApplicationCoreAssignment=0, OsAppIsrRef=RxHwSerialInt0
      OsApplicationHooks: OsAppErrorHook=false, OsAppShutdownHook=false, OsAppStartupHook=false
    RxHwSerialInt0 (OsIsr):
      OsTrusted = true
      OsIsrInterruptNumber = INTNO_SIO_CORE0
      OsIsrInterruptPriority = INTPRI_SIO_CORE0
      OsIsrStackSize = 592
      OsIsrCategory = CATEGORY_2
      OsIsrInterruptSource = ENABLE
    OSAP_for_RxHwSerialInt1 (OsApplication): OsTrusted=true, OsApplicationCoreAssignment=1, OsAppIsrRef=RxHwSerialInt1
      OsApplicationHooks: OsAppErrorHook=false, OsAppShutdownHook=false, OsAppStartupHook=false
    RxHwSerialInt1 (OsIsr):
      OsTrusted = true
      OsIsrInterruptNumber = INTNO_SIO_CORE1
      OsIsrInterruptPriority = INTPRI_SIO_CORE1
      OsIsrStackSize = 592
      OsIsrCategory = CATEGORY_2
      OsIsrInterruptSource = ENABLE
